## br-ext-chip-ingenic/configs/t31_install_wyzec3_defconfig
```kconfig
# Architecture
BR2_mipsel=y
BR2_mips_xburst=y
# BR2_MIPS_SOFT_FLOAT is not set
BR2_MIPS_FP32_MODE_32=y
# BR2_MIPS_FP32_MODE_XX is not set
BR2_MIPS_NAN_LEGACY=y
BR2_MIPS_OABI32=y
BR2_KERNEL_HEADERS_VERSION=y
BR2_DEFAULT_KERNEL_VERSION="3.10.14"
BR2_PACKAGE_HOST_LINUX_HEADERS_CUSTOM_3_10=y

# Toolchain
BR2_PER_PACKAGE_DIRECTORIES=y
BR2_GCC_VERSION_8_X=y
# BR2_TOOLCHAIN_USES_UCLIBC is not set
# BR2_TOOLCHAIN_BUILDROOT_UCLIBC is not set
# BR2_TOOLCHAIN_BUILDROOT_LIBC="uclibc"
BR2_EXTRA_GCC_CONFIG_OPTIONS="--with-float=hard"
BR2_TOOLCHAIN_USES_MUSL=y
BR2_TOOLCHAIN_BUILDROOT_MUSL=y
BR2_TOOLCHAIN_BUILDROOT_LIBC="musl"
BR2_TOOLCHAIN_BUILDROOT_CXX=y
BR2_TOOLCHAIN_BUILDROOT_LOCALE=y
BR2_TOOLCHAIN_BUILDROOT_USE_SSP=y

# U-Boot
#BR2_TARGET_UBOOT=y
#BR2_TARGET_UBOOT_SPL=y
#BR2_TARGET_UBOOT_USE_CUSTOM_CONFIG=y
#BR2_TARGET_UBOOT_CUSTOM_CONFIG_FILE="$(BR2_EXTERNAL_INGENIC_PATH)/board/t31/uboot/t31.wyzec3.config"
#BR2_TARGET_UBOOT_BOARDNAME="isvp_t31_sfcnor_ddr128M_wyzev3"
#BR2_TARGET_UBOOT_CUSTOM_VERSION=y
#BR2_TARGET_UBOOT_CUSTOM_VERSION_VALUE="2013.07"
#BR2_TARGET_UBOOT_PATCH="$(BR2_EXTERNAL_INGENIC_PATH)/board/t31/uboot/patches/"
#BR2_TARGET_UBOOT_SPL_NAME="spl/u-boot-spl-dtb.bin"

# Kernel
BR2_LINUX_KERNEL=y
BR2_LINUX_KERNEL_CUSTOM_VERSION=y
BR2_LINUX_KERNEL_CUSTOM_VERSION_VALUE="3.10.14"
BR2_LINUX_KERNEL_USE_CUSTOM_CONFIG=y
BR2_LINUX_KERNEL_CUSTOM_CONFIG_FILE="$(BR2_EXTERNAL_INGENIC_PATH)/board/t31/kernel/t31.wyzec3.config"
BR2_LINUX_KERNEL_UIMAGE=y
BR2_LINUX_KERNEL_LZMA=y
BR2_LINUX_KERNEL_EXT_INGENIC_PATCHER=y
BR2_LINUX_KERNEL_EXT_INGENIC_PATCHER_LIST="$(BR2_EXTERNAL_INGENIC_PATH)/board/t31/kernel/patches/ $(BR2_EXTERNAL_INGENIC_PATH)/board/t31/kernel/overlay"

# Filesystem
# BR2_TARGET_TZ_INFO is not set
BR2_TARGET_ROOTFS_CPIO=y
BR2_TARGET_ROOTFS_SQUASHFS=y
BR2_TARGET_ROOTFS_SQUASHFS4_XZ=y
BR2_ROOTFS_OVERLAY="$(TOPDIR)/../general/overlay"
BR2_ROOTFS_POST_BUILD_SCRIPT="$(TOPDIR)/../scripts/executing_commands_for_$(BR2_TOOLCHAIN_BUILDROOT_LIBC).sh"
BR2_PACKAGE_MTD=y
BR2_PACKAGE_MTD_MTDPART=y

## Used to build the mmc factory upgrade image
BR2_TARGET_ROOTFS_INITRAMFS=y

# WyreCam configuration
BR2_TOOLCHAIN_BUILDROOT_VENDOR="wyrecam"
BR2_TARGET_GENERIC_ISSUE="Welcome to WyreCam"
BR2_TARGET_GENERIC_HOSTNAME="wyrecam-wyzec3"
BR2_GLOBAL_PATCH_DIR="$(TOPDIR)/../general/package/all-patches"

# OpenIPC packages
BR2_PACKAGE_BUSYBOX_CONFIG="$(TOPDIR)/../general/package/busybox/busybox.config"
#BR2_PACKAGE_DROPBEAR_OPENIPC=y
BR2_PACKAGE_FWPRINTENV_OPENIPC=y
BR2_PACKAGE_INGENIC_OSDRV_T31=y

# WyreCam packages
#BR2_PACKAGE_INGENIC_VIDEOCAP=y
#BR2_PACKAGE_FFMPEG_OPENIPC=y

#BR2_PACKAGE_V4L2LOOPBACK_OPENIPC=y
#BR2_PACKAGE_V4L2LOOPBACK_UTILS_OPENIPC=y
#BR2_PACKAGE_V4L2RTSPSERVER=y

#BR2_PACKAGE_T31_RTSPD_WYRECAM=y


# WiFi
BR2_PACKAGE_WIRELESS_TOOLS=y
BR2_PACKAGE_WPA_SUPPLICANT=y
BR2_PACKAGE_WPA_SUPPLICANT_CLI=y
BR2_PACKAGE_WPA_SUPPLICANT_NL80211=y
BR2_PACKAGE_WPA_SUPPLICANT_PASSPHRASE=y
BR2_PACKAGE_LINUX_FIRMWARE_OPENIPC=y
BR2_PACKAGE_LINUX_FIRMWARE_OPENIPC_MT7601U=y

# DEBUG
# BR2_PACKAGE_HOST_GDB=y
# BR2_PACKAGE_GDB=y
# BR2_PACKAGE_LIBPTHREAD_STUBS=y
# BR2_PACKAGE_ARGP_STANDALONE=y
# BR2_PACKAGE_LTRACE_OPENIPC=y
# BR2_PACKAGE_GDB_DEBUGGER=y
# BR2_PACKAGE_GDB_SERVER=y

# Buildroot configuration
BR2_CCACHE=y
BR2_CCACHE_DIR="$(HOME)/.buildroot-ccache"
BR2_CCACHE_INITIAL_SETUP=""
BR2_CCACHE_USE_BASEDIR=y
```

## general/package/ingenic_videocap/Config.in
```kconfig
config BR2_PACKAGE_INGENIC_VIDEOCAP
	bool "ingenic_videocap"
	depends on BR2_USE_MMU # fork
	depends on BR2_TOOLCHAIN_HAS_THREADS # alsa-lib
	depends on !BR2_STATIC_LIBS
	depends on BR2_PACKAGE_INGENIC_OSDRV_T31
	select BR2_PACKAGE_ALSA_LIB
	help
	  ingenic_videocap
```

## general/package/live555-wyrecam/Config.in
```kconfig
config BR2_PACKAGE_LIVE555_WYRECAM
	bool "live555-wyrecam"
	select BR2_INSTALL_LIBSTDCPP
	depends on BR2_INSTALL_LIBSTDCPP
	depends on !BR2_STATIC_LIBS
	help
	  LIVE555 Streaming Media forms a set of C++ libraries for multimedia
	  streaming, using open standard protocols (RTP/RTCP, RTSP, SIP).

	  http://www.live555.com/liveMedia/

comment "live555 needs a toolchain w/ C++, dynamic library"
	depends on !BR2_INSTALL_LIBSTDCPP || BR2_STATIC_LIBS
```

## general/package/positron_wyrecam/Config.in
```kconfig
config BR2_PACKAGE_POSITRON_WYRECAM
	bool "positron"
	depends on BR2_PACKAGE_JPEG
	depends on BR2_PACKAGE_JPEG_TURBO
	depends on BR2_PACKAGE_MBEDTLS_OPENIPC
	depends on BR2_PACKAGE_AVAHI
	help
	  positron
```

## general/package/t31_rtspd_wyrecam/Config.in
```kconfig
config BR2_PACKAGE_T31_RTSPD_WYRECAM
	bool "t31-rtspd"
	select BR2_PACKAGE_LIVE555_WYRECAM
	help
	  t31-rtspd
```

## general/package/v4l2rtspserver/Config.in
```kconfig
comment "v4l2rtspserver uses v4l2cpp, log4cpp, live555, "
config BR2_PACKAGE_V4L2RTSPSERVER
	bool "v4l2rtspserver"
	select BR2_PACKAGE_V4L2CPP 
	select BR2_PACKAGE_LIVE555_OPENIPC
	select BR2_PACKAGE_LOG4CPP
	select BR2_PACKAGE_ALSA_LIB
	select BR2_PACKAGE_LAME_OPENIPC
	help
	  Provides a streaming RTSP server for the target.
```
